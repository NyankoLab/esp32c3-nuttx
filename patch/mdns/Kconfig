## patch/mdns/Kconfig
```kconfig
#
# For a description of the syntax of this configuration file,
# see kconfig-language at https://www.kernel.org/doc/Documentation/kbuild/kconfig-language.txt
#

config NETUTILS_MDNS
	bool "Multicast DNS"
	default n
	select PIPES
	---help---
		Enables support for Multicast DNS. The multicast Domain Name System (mDNS)
		resolves host names to IP addresses within small networks that do not include
		a local name server.
```
